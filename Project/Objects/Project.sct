; *************************************************************
; *** Scatter-Loading Description File generated by uVision ***
; *************************************************************

LR_IROM1 0x08000000 0x00100000  {    ; load region size_region
  ER_IROM1 0x08000000 0x00100000  {  ; load address = execution address
   *.o (RESET, +First)
   *(InRoot$$Sections)
   .ANY (+RO)
   .ANY (+XO)
  }
  RW_IRAM1 0x20000000 0x00015000  {  ; RW data
   .ANY (+RW +ZI)
  }
  RW_RAM1 0xC0000000 0x01000000  {
    activesock.o (+ZI +RW)
    addr_resolv_sock.o (+ZI +RW)
    array.o (+ZI +RW)
    config.o (+ZI +RW)
    ctype.o (+ZI +RW)
    errno.o (+ZI +RW)
    except.o (+ZI +RW)
    fifobuf.o (+ZI +RW)
    file_access_unistd.o (+ZI +RW)
    file_io_ansi.o (+ZI +RW)
    guid.o (+ZI +RW)
    guid_simple.o (+ZI +RW)
    hash.o (+ZI +RW)
    ioqueue_select.o (+ZI +RW)
    ip_helper_generic.o (+ZI +RW)
    list_1.o (+ZI +RW)
    lock.o (+ZI +RW)
    log.o (+ZI +RW)
    log_writer_stdout.o (+ZI +RW)
    os_core_unix.o (+ZI +RW)
    os_error_unix.o (+ZI +RW)
    os_info.o (+ZI +RW)
    os_time_common.o (+ZI +RW)
    os_time_unix.o (+ZI +RW)
    os_timestamp_common.o (+ZI +RW)
    os_timestamp_posix.o (+ZI +RW)
    pool.o (+ZI +RW)
    pool_buf.o (+ZI +RW)
    pool_caching.o (+ZI +RW)
    pool_dbg.o (+ZI +RW)
    pool_policy_malloc.o (+ZI +RW)
    rand.o (+ZI +RW)
    rbtree.o (+ZI +RW)
    sock_bsd.o (+ZI +RW)
    sock_common.o (+ZI +RW)
    sock_qos_bsd.o (+ZI +RW)
    sock_qos_common.o (+ZI +RW)
    sock_select.o (+ZI +RW)
    ssl_sock_common.o (+ZI +RW)
    ssl_sock_dump.o (+ZI +RW)
    ssl_sock_ossl.o (+ZI +RW)
    string.o (+ZI +RW)
    symbols.o (+ZI +RW)
    timer.o (+ZI +RW)
    types.o (+ZI +RW)
    base64_1.o (+ZI +RW)
    cli.o (+ZI +RW)
    cli_console.o (+ZI +RW)
    cli_telnet.o (+ZI +RW)
    crc32.o (+ZI +RW)
    dns.o (+ZI +RW)
    dns_dump.o (+ZI +RW)
    dns_server.o (+ZI +RW)
    errno_1.o (+ZI +RW)
    getopt.o (+ZI +RW)
    hmac_md5.o (+ZI +RW)
    hmac_sha1.o (+ZI +RW)
    http_client.o (+ZI +RW)
    json.o (+ZI +RW)
    md5_1.o (+ZI +RW)
    pcap.o (+ZI +RW)
    resolver.o (+ZI +RW)
    scanner.o (+ZI +RW)
    sha1_1.o (+ZI +RW)
    srv_resolver.o (+ZI +RW)
    string_1.o (+ZI +RW)
    stun_simple.o (+ZI +RW)
    stun_simple_client.o (+ZI +RW)
    symbols_1.o (+ZI +RW)
    xml.o (+ZI +RW)
    alaw_ulaw.o (+ZI +RW)
    alaw_ulaw_table.o (+ZI +RW)
    audiodev.o (+ZI +RW)
    avi_player.o (+ZI +RW)
    bidirectional.o (+ZI +RW)
    clock_thread.o (+ZI +RW)
    codec.o (+ZI +RW)
    conf_switch.o (+ZI +RW)
    conference.o (+ZI +RW)
    converter.o (+ZI +RW)
    converter_libswscale.o (+ZI +RW)
    converter_libyuv.o (+ZI +RW)
    delaybuf.o (+ZI +RW)
    dummy.o (+ZI +RW)
    echo_common.o (+ZI +RW)
    echo_port.o (+ZI +RW)
    echo_suppress.o (+ZI +RW)
    echo_webrtc.o (+ZI +RW)
    endpoint.o (+ZI +RW)
    errno_2.o (+ZI +RW)
    event.o (+ZI +RW)
    ffmpeg_util.o (+ZI +RW)
    format.o (+ZI +RW)
    g711.o (+ZI +RW)
    jbuf.o (+ZI +RW)
    master_port.o (+ZI +RW)
    mem_capture.o (+ZI +RW)
    mem_player.o (+ZI +RW)
    null_port.o (+ZI +RW)
    plc_common.o (+ZI +RW)
    port_1.o (+ZI +RW)
    resample_libsamplerate.o (+ZI +RW)
    resample_port.o (+ZI +RW)
    resample_speex.o (+ZI +RW)
    rtcp.o (+ZI +RW)
    rtcp_fb.o (+ZI +RW)
    rtcp_xr.o (+ZI +RW)
    rtp.o (+ZI +RW)
    sdp.o (+ZI +RW)
    sdp_cmp.o (+ZI +RW)
    sdp_neg.o (+ZI +RW)
    session.o (+ZI +RW)
    silencedet.o (+ZI +RW)
    sound_legacy.o (+ZI +RW)
    sound_port.o (+ZI +RW)
    splitcomb.o (+ZI +RW)
    stereo_port.o (+ZI +RW)
    stream.o (+ZI +RW)
    stream_common.o (+ZI +RW)
    stream_info.o (+ZI +RW)
    tonegen.o (+ZI +RW)
    transport_adapter_sample.o (+ZI +RW)
    transport_ice.o (+ZI +RW)
    transport_loop.o (+ZI +RW)
    transport_udp.o (+ZI +RW)
    types_1.o (+ZI +RW)
    wav_player.o (+ZI +RW)
    wav_playlist.o (+ZI +RW)
    wav_writer.o (+ZI +RW)
    wave.o (+ZI +RW)
    wsola.o (+ZI +RW)
    echo_speex.o (+ZI +RW)
    resample_resample.o (+ZI +RW)
    audiodev_1.o (+ZI +RW)
    audiotest.o (+ZI +RW)
    errno_3.o (+ZI +RW)
    null_dev.o (+ZI +RW)
    stm_dev.o (+ZI +RW)
    amr_sdp_match.o (+ZI +RW)
    audio_codecs.o (+ZI +RW)
    bcg729.o (+ZI +RW)
    g722.o (+ZI +RW)
    g7221.o (+ZI +RW)
    g7221_sdp_match.o (+ZI +RW)
    gsm.o (+ZI +RW)
    ilbc.o (+ZI +RW)
    l16.o (+ZI +RW)
    opencore_amr.o (+ZI +RW)
    opus.o (+ZI +RW)
    passthrough.o (+ZI +RW)
    silk.o (+ZI +RW)
    speex_codec.o (+ZI +RW)
    vpx.o (+ZI +RW)
    vpx_packetizer.o (+ZI +RW)
    g722_dec.o (+ZI +RW)
    g722_enc.o (+ZI +RW)
    errno_4.o (+ZI +RW)
    ice_session.o (+ZI +RW)
    ice_strans.o (+ZI +RW)
    nat_detect.o (+ZI +RW)
    stun_auth.o (+ZI +RW)
    stun_msg.o (+ZI +RW)
    stun_msg_dump.o (+ZI +RW)
    stun_session.o (+ZI +RW)
    stun_sock.o (+ZI +RW)
    stun_transaction.o (+ZI +RW)
    turn_session.o (+ZI +RW)
    turn_sock.o (+ZI +RW)
    allocation.o (+ZI +RW)
    auth.o (+ZI +RW)
    listener_tcp.o (+ZI +RW)
    listener_udp.o (+ZI +RW)
    server.o (+ZI +RW)
    sip_auth_aka.o (+ZI +RW)
    sip_auth_client.o (+ZI +RW)
    sip_auth_msg.o (+ZI +RW)
    sip_auth_parser.o (+ZI +RW)
    sip_auth_server.o (+ZI +RW)
    sip_config.o (+ZI +RW)
    sip_dialog.o (+ZI +RW)
    sip_endpoint.o (+ZI +RW)
    sip_errno.o (+ZI +RW)
    sip_msg.o (+ZI +RW)
    sip_multipart.o (+ZI +RW)
    sip_parser.o (+ZI +RW)
    sip_resolve.o (+ZI +RW)
    sip_tel_uri.o (+ZI +RW)
    sip_transaction.o (+ZI +RW)
    sip_transport.o (+ZI +RW)
    sip_transport_loop.o (+ZI +RW)
    sip_transport_tcp.o (+ZI +RW)
    sip_transport_tls.o (+ZI +RW)
    sip_transport_udp.o (+ZI +RW)
    sip_ua_layer.o (+ZI +RW)
    sip_uri.o (+ZI +RW)
    sip_util.o (+ZI +RW)
    sip_util_proxy.o (+ZI +RW)
    sip_util_statefull.o (+ZI +RW)
    errno_5.o (+ZI +RW)
    evsub.o (+ZI +RW)
    evsub_msg.o (+ZI +RW)
    iscomposing.o (+ZI +RW)
    mwi.o (+ZI +RW)
    pidf.o (+ZI +RW)
    presence.o (+ZI +RW)
    presence_body.o (+ZI +RW)
    publishc.o (+ZI +RW)
    rpid.o (+ZI +RW)
    xpidf.o (+ZI +RW)
    sip_100rel.o (+ZI +RW)
    sip_inv.o (+ZI +RW)
    sip_reg.o (+ZI +RW)
    sip_replaces.o (+ZI +RW)
    sip_timer.o (+ZI +RW)
    sip_xfer.o (+ZI +RW)
    pjsua_acc.o (+ZI +RW)
    pjsua_aud.o (+ZI +RW)
    pjsua_call.o (+ZI +RW)
    pjsua_core.o (+ZI +RW)
    pjsua_dump.o (+ZI +RW)
    pjsua_im.o (+ZI +RW)
    pjsua_media.o (+ZI +RW)
    pjsua_pres.o (+ZI +RW)
    pjsua_vid.o (+ZI +RW)
    dct4_a.o (+ZI +RW)
    encoder.o (+ZI +RW)
    sam2coef.o (+ZI +RW)
    coef2sam.o (+ZI +RW)
    dct4_s.o (+ZI +RW)
    decoder.o (+ZI +RW)
    basic_op.o (+ZI +RW)
    common.o (+ZI +RW)
    huff_tab.o (+ZI +RW)
    tables.o (+ZI +RW)
    bits.o (+RW)
    buffer.o (+RW)
    cb_search.o (+RW)
    exc_10_32_table.o (+RW)
    fftwrap.o (+RW)
    filterbank.o (+RW)
    filters.o (+RW)
    gain_table.o (+RW)
    gain_table_lbr.o (+RW)
    hexc_10_32_table.o (+RW)
    hexc_table.o (+RW)
    high_lsp_tables.o (+RW)
    jitter.o (+RW)
    kiss_fft.o (+RW)
    kiss_fftr.o (+RW)
    lpc.o (+RW)
    lsp.o (+RW)
    lsp_tables_nb.o (+RW)
    ltp.o (+RW)
    mdf.o (+RW)
    modes.o (+RW)
    modes_wb.o (+RW)
    nb_celp.o (+RW)
    preprocess.o (+RW)
    quant_lsp.o (+RW)
    resample.o (+RW)
    sb_celp.o (+RW)
    scal.o (+RW)
    smallft.o (+RW)
    speex.o (+RW)
    speex_callbacks.o (+RW)
    speex_header.o (+RW)
    stereo.o (+RW)
    vbr.o (+RW)
    vorbis_psy.o (+RW)
    vq.o (+RW)
    window.o (+RW)
    exc_5_64_table.o (+RW)
    exc_5_256_table.o (+RW)
    exc_8_128_table.o (+RW)
    exc_10_16_table.o (+RW)
    exc_20_32_table.o (+RW)
  }
}

